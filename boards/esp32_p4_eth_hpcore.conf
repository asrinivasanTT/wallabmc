## boards/waveshare/esp32_p4_eth/Kconfig.defconfig
```kconfig
# Waveshare ESP32-P4-ETH board configuration
# SPDX-License-Identifier: Apache-2.0

if BOARD_ESP32_P4_ETH_ESP32P4_HPCORE

configdefault NET_L2_ETHERNET
	default y

endif # BOARD_ESP32_P4_ETH_ESP32P4_HPCORE
```

## boards/waveshare/esp32_p4_eth/Kconfig.esp32_p4_eth
```kconfig
# Waveshare ESP32-P4-ETH board configuration
# SPDX-License-Identifier: Apache-2.0

config BOARD_ESP32_P4_ETH
	bool
	select SOC_ESP32P4_REV_1_3
	select SOC_ESP32P4_HPCORE if BOARD_ESP32_P4_ETH_ESP32P4_HPCORE
```

## boards/waveshare/esp32_p4_eth/board.yml
```yaml
board:
  name: esp32_p4_eth
  full_name: Waveshare ESP32-P4-ETH
  vendor: waveshare
  socs:
  - name: esp32p4
```
